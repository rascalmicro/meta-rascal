## conf/layer.conf
```bitbake
# We have a conf directory, append to BBPATH
BBPATH .= ":${LAYERDIR}"

# We have a recipes directory, add to BBFILES	
BBFILES += "${LAYERDIR}/recipes*/*/*.bb ${LAYERDIR}/recipes*/*/*.bbappend ${LAYERDIR}/recipes*/*.bb"

BBFILE_COLLECTIONS += "rascal"
BBFILE_PATTERN_rascal := "^${LAYERDIR}/"
BBFILE_PRIORITY_rascal = "7"
```

## conf/machine/rascal.conf
```bitbake
MACHINE ?= "at91sam9g20ek"

IMAGE_FSTYPES = "ext3 tar.bz2"

SERIAL_CONSOLE = "115200 ttyS0"
```
